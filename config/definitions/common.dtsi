/*
 *
 * Copyright (c) 2025 Ryan Luckie
 * SPDX-License-Identifier: MIT
 *
 */

#include <behaviors.dtsi>
#include <dt-bindings/zmk/keys.h>
#include <dt-bindings/zmk/bt.h>


#include "config.dtsi"
#include "keycodes.h"

#include "../features/homerow.dtsi"
#include "../features/combos.dtsi"
#include "../features/smart.dtsi"
// #include "../features/leader.dtsi"
#include "../features/mouse.dtsi"
#include "../features/select.dtsi"
#include "../features/symbols.dtsi"
#include "../features/shortcuts.dtsi"


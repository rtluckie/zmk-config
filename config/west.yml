## config/west.yml
```yaml
manifest:
  defaults:
    remote: urob
    revision: v0.3 # Pin everything to v0.3
  remotes:
    - name: zmkfirmware
      url-base: https://github.com/zmkfirmware
    - name: caksoylar
      url-base: https://github.com/caksoylar
    - name: urob
      url-base: https://github.com/urob
    - name: englmaxi
      url-base: https://github.com/englmaxi
    - name: ssbb
      url-base: https://github.com/ssbb
    - name: joelspadin
      url-base: https://github.com/joelspadin
  projects:
    - name: zmk
      remote: zmkfirmware
      import: app/west.yml
    - name: zephyr
      remote: zmkfirmware
      revision: v3.5.0+zmk-fixes
      clone-depth: 1
      import:
        name-allowlist:
          - cmsis
          - hal_nordic
          - hal_rpi_pico
          - hal_stm32
          - lvgl
          - tinycrypt 
    # modules
    - name: zmk-rgbled-widget
      remote: caksoylar
      revision: main
      path: modules/zmk/rgbled-widget
    - name: zmk-tri-state
      remote: urob
      revision: main
      path: modules/zmk/tri-state
    - name: zmk-dongle-display
      remote: englmaxi
      revision: main
      path: modules/zmk/dongle-display
    - name: zmk-antecedent-morph
      remote: ssbb
      revision: main
      path: modules/zmk/antecedent-morph
    - name: zmk-locales
      remote: joelspadin
      revision: main
      path: modules/zmk/locales
  self:
    path: config
```

/*
 * Copyright (c) 2024 Thiago Alves
 *
 * SPDX-License-Identifier: MIT
 */

// Hyper Key: ⇧ ⌥ ^ ⌘ (Shift + Alt + Control + Command)
#define LEFT_HYPER             LS(LA(LC(LGUI)))
#define LHYP                   LEFT_HYPER
#define RIGHT_HYPER            RS(RA(RC(RGUI)))
#define RHYP                   RIGHT_HYPER

// Hyper Key function like LG and RG
#define LH(keycode)            LS(LA(LC(LG(keycode))))
#define RH(keycode)            RS(RA(RC(RG(keycode))))

// Meh Key: ⇧ ⌥ ^ (Shift + Alt + Control)
#define LEFT_MEH               LS(LA(LCTRL))
#define LMEH                   LEFT_MEH
#define RIGHT_MEH              RS(RA(RCTRL))
#define RMEH                   RIGHT_MEH

// Meh Key function like LG and RG
#define LM(keycode)            LS(LA(LC(keycode)))
#define RM(keycode)            RS(RA(RC(keycode)))

// Keys I feel should be part of ZMK
#define BACK_TAB               LS(TAB)
#define BTAB                   BACK_TAB

// macOS Keys and common shortcuts
#define MAC_LAUNCHPAD          C_AC_DESKTOP_SHOW_ALL_APPLICATIONS
#define MAC_LP                 MAC_LAUNCHPAD
#define MAC_MISSION_CONTROL    C_AC_DESKTOP_SHOW_ALL_WINDOWS
#define MAC_MC                 MAC_MISSION_CONTROL
#define MAC_SPOTLIGHT          C_AC_SEARCH
#define MAC_SP                 MAC_SPOTLIGHT
#define MAC_CUT                LG(X)
#define MAC_COPY               LG(C)
#define MAC_PASTE              LG(V)
#define MAC_UNDO               LG(Z)
#define MAC_REDO               LG(LS(Z))
#define MAC_APP_WINDOWS        LG(LC(DOWN))   // Show windows from current application
#define MAC_APPWIN             MAC_APP_WINDOWS
#define MAC_NEXT_WINDOW        LG(GRAVE)      // Go to the next window on the same application
#define MAC_WINN               MAC_NEXT_WINDOW
#define MAC_PREVIOUS_WINDOW    LG(TILDE)      // Go to the previous window on the same application
#define MAC_WINP               MAC_PREVIOUS_WINDOW
#define MAC_NEXT_DESKTOP       LG(LC(RIGHT))  // Go to the next virtual desktop
#define MAC_DKTN               MAC_NEXT_DESKTOP
#define MAC_PREVIOUS_DESKTOP   LG(LC(LEFT))   // Go to the previous virtual desktop
#define MAC_DKTP               MAC_PREVIOUS_DESKTOP
#define MAC_FIND_NEXT          LG(G)
#define MAC_FDNXT              MAC_FIND_NEXT
#define MAC_FIND_PREVIOUS      LG(LS(G))
#define MAC_FDPRV              MAC_FIND_PREVIOUS
#define MAC_NEXT_WORD          LA(RIGHT)
#define MAC_WRDN               MAC_NEXT_WORD
#define MAC_PREVIOUS_WORD      LA(LEFT)
#define MAC_WRDP               MAC_PREVIOUS_WORD
#define MAC_START_OF_LINE      LG(LEFT)
#define MAC_STTL               MAC_START_OF_LINE
#define MAC_END_OF_LINE        LG(RIGHT)
#define MAC_ENDL               MAC_END_OF_LINE

// RGB Helpers
#define RGB_RESET              RGB_COLOR_HSB(0, 0, 60)

// This helper macro allow one to define a normal key with a special output with
// pressing shift. This is useful when you want to create a key that, its
// shifted value, differs from the standard behavior.
#define DEFINE_SHIFT_KEY(_behavior_name, _normal_key, _shifted_key) \
    _behavior_name: _behavior_name {                                \
      compatible = "zmk,behavior-mod-morph";                        \
      #binding-cells = <0>;                                         \
      bindings = <_normal_key>, <_shifted_key>;                     \
      mods = <(MOD_LSFT|MOD_RSFT)>;                                 \
    }

// Internal helper macro to allow us to define all our reversed number keys.
// This macro should NOT be used outside this file!
#define __NUM_REVERSE(_number, _symbol)  DEFINE_SHIFT_KEY(kp_r ## _number, &kp _symbol, &kp _number)

// Next are keys I want to modify their standard behavior, like sending an `@`
// character when pressing the number `9` with a shift modifier, instead of a
// `(` one. All behaviors defined for the sole purpose of redefining a single
// key will prefixed with `kp_` to make it easy to identify them.
/ {
  behaviors {
    // Make the `BACKSPACE` key behaves like `DEL`, when holding shift down.
    // This mimics the standard backspace behavior on Mac Books.
    DEFINE_SHIFT_KEY(kp_bspcdel, &kp BACKSPACE, &kp DELETE);

    // The next 10 key behaviors invert the normal number keys. This means that
    // instead of  a "number" with tap and a "symbol" with shift-tap, the key
    // will be a "symbol" with tap, and a "number" with a shift-tap. The
    // `__NUM_REVERSE` macro will generate a behavior named `kp_rN<x>`, where
    // `<x>` is the number being reversed:
    __NUM_REVERSE(N1, EXCLAMATION);
    __NUM_REVERSE(N2, AT);
    __NUM_REVERSE(N3, HASH);
    __NUM_REVERSE(N4, DOLLAR);
    __NUM_REVERSE(N5, PERCENT);
    __NUM_REVERSE(N6, CARET);
    __NUM_REVERSE(N7, AMPERSAND);
    __NUM_REVERSE(N8, ASTERISK);
    __NUM_REVERSE(N9, LEFT_PARENTHESIS);
    __NUM_REVERSE(N0, RIGHT_PARENTHESIS);

    // Media keys, usually, have action keys as symetric pairs. This means that
    // if we have a key to raise the volume, we have a key to lower it. On
    // small-factor keyboards, this is a waste of key real-state, so for each
    // symetric pair of media keys I have, I'll creat a key that performs the
    // "down" action when pressed, and the "up" action when tapped with `Shift`
    // held down:
    DEFINE_SHIFT_KEY(kp_volume,  &kp C_VOLUME_DOWN,    &kp C_VOLUME_UP);      // Volume
    DEFINE_SHIFT_KEY(kp_bklight, &bl BL_DEC,           &bl BL_INC);           // Keyboard backlight
    DEFINE_SHIFT_KEY(kp_scrbri,  &kp C_BRIGHTNESS_DEC, &kp C_BRIGHTNESS_INC); // Screen brightness
    DEFINE_SHIFT_KEY(kp_rgbhue,  &rgb_ug RGB_HUD,      &rgb_ug RGB_HUI);      // RGB HSL Hue
    DEFINE_SHIFT_KEY(kp_rgbsat,  &rgb_ug RGB_SAD,      &rgb_ug RGB_SAI);      // RGB HSL Saturation
    DEFINE_SHIFT_KEY(kp_rgbbri,  &rgb_ug RGB_BRD,      &rgb_ug RGB_BRI);      // RGB HSL Brightness

    // The GLOBE key does not have all the functionalities Apple's version of
    // the key has, so I'm adding a new one to it:
    // When you double-tap it, it will activate the CAPS-WORD mode.
    globecaps: globe_or_caps_word {
      compatible = "zmk,behavior-tap-dance";
      #binding-cells = <0>;
      tapping-term-ms = <200>;
      bindings = <&kp GLOBE>, <&caps_word>;
    };
  };
};

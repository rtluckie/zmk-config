/*
*
* Copyright (c) 2025 Ryan Luckie
* SPDX-License-Identifier: MIT
*
*/
#include <behaviors.dtsi>
#include <dt-bindings/zmk/keys.h>
#include "zmk-helpers/helper.h"

ZMK_BEHAVIOR(win_sleep, macro,
    wait-ms = <100>;
    tap-ms = <5>;
 
    bindings = <&kp LG(X) &kp U &kp S>;
)
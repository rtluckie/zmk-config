&sk {
	release-after-ms = <900>;
	quick-release;
};

&sl {
	release-after-ms = <10000>;
	ignore-modifiers;
};

&mt {
	flavor = "tap-preferred";
	tapping-term-ms = <220>;
	quick-tap-ms = <220>;
	hold-trigger-key-positions = <0>;
};

&lt {
	flavor = "balanced";
	tapping-term-ms = <200>;
	quick-tap-ms = <175>;
};


#define CAPS_COMBO_MS 125
#define VERT_COMBO_MS 75
#define TRI_COMBO_MS  50
#define ROLL_COMBO_MS 25


#define VER_PATCH N1
#define VER_MINOR N0
#define VER_MAJOR N0


// Layers
#define ALPHA 0
#define LOWER 1
#define RAISE 2
#define ADJUST 3
#define EXTEND 4
#define ACTIONS 5
#define MEDIA 6
#define SHORTCUTS 7
#define SYSTEM 8
#define NAV 9
#define NUM 10
#define POINTER 11
#define SYMBOLS 12
#define TEXT 13
#define LAYERS 14
#define WIN 15
#define FUNC 16


#include "layers/00_alpha.dtsi"
#include "layers/01_lower.dtsi"
#include "layers/02_raise.dtsi"
#include "layers/03_adjust.dtsi"
#include "layers/04_extend.dtsi"
#include "layers/09_actions.dtsi"
#include "layers/10_media.dtsi"
#include "layers/11_shortcuts.dtsi"
#include "layers/12_system.dtsi"
#include "layers/13_nav.dtsi"
#include "layers/14_num.dtsi"
#include "layers/15_pointer.dtsi"
#include "layers/16_symbols.dtsi"
#include "layers/17_text.dtsi"
#include "layers/18_layers.dtsi"
#include "layers/19_windows.dtsi"
#include "layers/20_func.dtsi"

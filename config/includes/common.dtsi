#include <behaviors.dtsi>
#include <behaviors/num_word.dtsi>// Requires auto-layer module.
#include <dt-bindings/zmk/keys.h>

#include <dt-bindings/zmk/bt.h>
#include <dt-bindings/zmk/outputs.h>

#include "zmk-helpers/helper.h"
